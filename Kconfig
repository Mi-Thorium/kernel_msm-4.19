## Kconfig
```kconfig
# SPDX-License-Identifier: GPL-2.0
#
# For a description of the syntax of this configuration file,
# see Documentation/kbuild/kconfig-language.txt.
#
mainmenu "Linux/$(ARCH) $(KERNELVERSION) Kernel Configuration"

comment "Compiler: $(CC_VERSION_TEXT)"

source "scripts/Kconfig.include"

source "init/Kconfig"

source "kernel/Kconfig.freezer"

source "fs/Kconfig.binfmt"

source "mm/Kconfig"

source "net/Kconfig"

source "drivers/Kconfig"

source "fs/Kconfig"

source "security/Kconfig"

source "crypto/Kconfig"

source "lib/Kconfig"

source "lib/Kconfig.debug"

source "techpack/Kconfig"

config KSU_STATIC_HOOKS
	bool "KernelSU: Force to use static hooks"
	default n
	help
	  Say Y here to force KernelSU to use static hooks.
	  This can avoid bootloop if the kernel has broken Kprobes support.

	  To use this whenever CONFIG_KPROBES=y, you'll need to execute the following command in KernelSU/kernel directory:
	  `sed -i 's|#ifdef CONFIG_KPROBES|#if defined(CONFIG_KPROBES) \&\& !defined(CONFIG_KSU_STATIC_HOOKS)|g;s|#ifndef CONFIG_KPROBES|#if !defined(CONFIG_KPROBES) \|\| defined(CONFIG_KSU_STATIC_HOOKS)|g' *.*`
```

## drivers/platform/motorola-msm8937/Kconfig
```kconfig
menu "Motorola MSM8937"

config MACH_MOTOROLA_MSM8937
	bool "Support for Motorola MSM8937 platform"
	depends on ARCH_MSM8937
	help
	  Say Y here to enable support for Motorola MSM8937 platform.

if MACH_MOTOROLA_MSM8937

config MACH_MOTOROLA_CEDRIC
	bool "Motorola CEDRIC"
	help
	  CEDRIC

config MACH_MOTOROLA_HANNAH
	bool "Motorola HANNAH"
	help
	  HANNAH

config MACH_MOTOROLA_JAMES
	bool "Motorola JAMES"
	help
	  JAMES

config MACH_MOTOROLA_JETER
	bool "Motorola JETER"
	help
	  JETER

config MACH_MOTOROLA_MONTANA
	bool "Motorola MONTANA"
	help
	  MONTANA

config MACH_MOTOROLA_NORA
	bool "Motorola NORA"
	help
	  NORA

config MACH_MOTOROLA_OWENS
	bool "Motorola OWENS"
	help
	  OWENS

config MACH_MOTOROLA_PERRY
	bool "Motorola PERRY"
	help
	  PERRY

endif # MACH_MOTOROLA_MSM8937

endmenu
```

## techpack/Kconfig
```kconfig
menu "Tech packages"

config TECHPACK_AUDIO_DISABLE
	bool "Disable compilation for audio module"
	default n
	help
	  Say Y here to disable compilation for audio module.
	  Sometimes useful for reducing kernel binary size.

source "techpack/data/Kconfig"

source "techpack/xiaomi-sdm439/Kconfig"

endmenu
```
