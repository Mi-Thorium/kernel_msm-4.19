#include "msm8937-audio.dtsi"
#include "msm8937.dtsi"
#include "msm8937-pinctrl.dtsi"
#include "pm8953.dtsi"
#include "pmi632.dtsi"
#include "sdm439-audio.dtsi"
#include "sdm439-ctp.dtsi"
#include "sdm439.dtsi"
#include "sdm439-mtp.dtsi"
#include "sdm439-pmi632.dtsi"
#include "sdm439-regulator.dtsi"
