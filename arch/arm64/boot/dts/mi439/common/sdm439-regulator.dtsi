&pm8953_l3 {
	regulator-min-microvolt = <1050000>;
	qcom,init-voltage = <1050000>;
};

&pm8953_l22 {
	regulator-min-microvolt = <2800000>;
	regulator-max-microvolt = <2900000>;
	qcom,init-voltage = <2800000>;
};
