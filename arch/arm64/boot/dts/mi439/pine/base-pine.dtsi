#include "../common/common.dtsi"
#include "msm8937-audio.dtsi"
#include "msm8937.dtsi"
#include "msm8937-pinctrl.dtsi"
#include "msm8937-regulator.dtsi"
#include "pmi632.dtsi"
#include "sdm439-ctp.dtsi"
#include "sdm439.dtsi"
#include "sdm439-pmi632.dtsi"
#include "sdm439-regulator.dtsi"
